## tfa986x/Kconfig
```kconfig
menu "Goodix TFA9866 amplifier configuration"

if SND_SOC_TFA986X
config TFA_MONO_NODE
        bool "Mono sysfs node support"
        default y
        help
          In application, it's necessary to differ nodes between channels.

endif # SND_SOC_TFA986X

endmenu
```
